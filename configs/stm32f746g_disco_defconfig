## configs/stm32f746g_disco_defconfig
```kconfig
BR2_arm=y
BR2_cortex_m4=y
BR2_SVN="svn"
BR2_KERNEL_HEADERS_4_9=y
BR2_GCC_VERSION_6_X=y
BR2_TARGET_GENERIC_HOSTNAME="STM32F746-disco"
# BR2_TARGET_GENERIC_REMOUNT_ROOTFS_RW is not set
# BR2_ENABLE_LOCALE_PURGE is not set
BR2_LINUX_KERNEL=y
BR2_LINUX_KERNEL_CUSTOM_TARBALL=y
BR2_LINUX_KERNEL_CUSTOM_TARBALL_LOCATION="https://cdn.kernel.org/pub/linux/kernel/v4.x/linux-4.15.7.tar.xz"
BR2_LINUX_KERNEL_USE_CUSTOM_CONFIG=y
BR2_LINUX_KERNEL_CUSTOM_CONFIG_FILE="board/stmicroelectronics/stm32f746g-disco/linux.config"
BR2_LINUX_KERNEL_DTS_SUPPORT=y
BR2_LINUX_KERNEL_CUSTOM_DTS_PATH="board/stmicroelectronics/stm32f746g-disco/stm32f746-disco.dts"
BR2_PACKAGE_BUSYBOX_CONFIG="board/stmicroelectronics/stm32f746g-disco/busybox.config"
BR2_TARGET_ROOTFS_INITRAMFS=y
# BR2_TARGET_ROOTFS_TAR is not set
BR2_TARGET_UBOOT=y
BR2_TARGET_UBOOT_BUILD_SYSTEM_KCONFIG=y
BR2_TARGET_UBOOT_CUSTOM_GIT=y
BR2_TARGET_UBOOT_CUSTOM_REPO_URL="http://git.denx.de/u-boot.git"
BR2_TARGET_UBOOT_CUSTOM_REPO_VERSION="v2018.03-rc3"
BR2_TARGET_UBOOT_PATCH="board/stmicroelectronics/stm32f746g-disco/patches/u-boot/u-boot.001_environment.patch"
BR2_TARGET_UBOOT_USE_CUSTOM_CONFIG=y
BR2_TARGET_UBOOT_CUSTOM_CONFIG_FILE="board/stmicroelectronics/stm32f746g-disco/u-boot.config"
BR2_TARGET_UBOOT_SPL=y
BR2_PACKAGE_HOST_OPENOCD=y
```
